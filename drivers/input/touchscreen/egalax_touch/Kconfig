## drivers/input/touchscreen/egalax_touch/Kconfig
```kconfig
#
# Egalax Touchscreen proprietary driver configuration
#

config TOUCHSCREEN_EGALAX_PROP
	tristate "EETI eGalax touch panel support - proprietary driver"
	depends on I2C && OF
	default n
	help
	  Say Y here to enable support for I2C connected EETI
	  eGalax multi-touch panels.

	  To compile this driver as a module, choose M here: the
	  module will be called egalax_touch.
```

## drivers/input/touchscreen/ilitek_touch/Kconfig
```kconfig
#
# Ilitek Touchscreen driver configuration
#

config TOUCHSCREEN_ILITEK
        tristate "Ilitek based Touchscreen"
		depends on I2C
		select INPUT_POLLDEV
		default n
		help
		  Say Y here if you have Ilitek based touch panel.
		  If unsure, say N.
```
