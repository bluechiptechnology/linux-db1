
#include "apq8016-sbc.dts"

&lvds {
        clock-frequency = <71884800>;
        hactive = <1280>;
        vactive = <800>;
        hback-porch = <0>;
        hsync-len = <10>;
        hfront-porch = <150>;
        vback-porch = <0>;
        vfront-porch = <22>;
        vsync-len = <10>;
        hsync-active = <0>;
        vsync-active = <0>;
        de-active = <1>;
        pixelclk-active = <0>;
};


&dsi_lvds_bridge {
    /* MSB bits in 4th LVDS lane */
    ti,lvds-format = <2>;

	ti,width-mm = <261>;
	ti,height-mm = <163>;
};


&dsi0_out {
	remote-endpoint = <&sn65dsi83_in>;
	data-lanes = <0 1 2 3>;
};

/* eGalax touch screen */
&pcap3 {
    status = "okay";
};


